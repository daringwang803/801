## kernel/arch/arm/mach-a380/Kconfig
```kconfig
#
# arch/arm/mach-a380/Kconfig
#

if MACH_A380

menu "Faraday A380 Platform Options"
	depends on MACH_A380

config UART_CLOCK
	int "UART clock tick rate"
	default 18432000 if MACH_A380
	help
	  The frequency of the UART reference clock.
	
config SND_SOC_WM8731_MCLK
	int "WM8731 master clock rate"
	default 12288000
	
config MACH_A380_VP
	bool "Faraday A380 VP EVB"
	help
	  Say Y here if you are using FARADAY A380-VP EVB
	
config FARADAY_CA9_TESTCHIP
	bool "Use Faraday Cortex-A9 Testchip"
	depends on CPU_CA9
	select FTINTC030
	default n
	help
	  Say Y here if you are using FARADAY CORTEX-A9 Testchip
	  
config FTSCU100
	bool
	help
	  FTSCU100 System Controller
	  
config SERDES_MULTI
	bool "Support Initial of Serdes(multi mode)"
	default y
	  
config FTPCIE_CDNG3
	bool "FTPCIE_CDNG3 PCI Express Support"
	depends on PCI
	help
	  FTPCIE_CDNG3 PCI Express Firmware
	  
endmenu

endif
```

## kernel/arch/arm/mach-leo/Kconfig
```kconfig
#
# arch/arm/mach-leo/Kconfig
#

if MACH_LEO

menu "Faraday LEO Platform Options"
	depends on MACH_LEO
	
config MACH_LEO_VP
	bool "Faraday LEO VP EVB"
	help
	  Say Y here if you are using FARADAY LEO-VP EVB
	 
config FTSCU100
	bool
	help
	  FTSCU100 System Controller
endmenu

endif
```

## kernel/arch/arm/plat-faraday/Kconfig
```kconfig
#
# SoC
#
choice
	prompt "Faraday Platform Type"
	default MACH_A380
	depends on ARCH_FARADAY

config MACH_A380
	bool "A380"
	select ARM_GIC if CPU_CA9
	select FARADAY_FTINTC030 if CPU_FA626TE
	select HAVE_ARM_SCU if SMP
	select HAVE_ARM_TWD if SMP
	select FTTMR010
	select FTSCU100
	select ARCH_REQUIRE_GPIOLIB
	select PINCTRL
	select PINCTRL_A380
	select PINCTRL_FTSCU010
	select SND_SOC_WM8731
	select VIRT_TO_BUS
	select WIRELESS_EXT
	select WEXT_PRIV
	select COMMON_CLK
	select TIMER_OF if OF

config MACH_LEO
	bool "LEO"
	select ARM_GIC
	select FTSCU100
	select ARCH_REQUIRE_GPIOLIB
	select PINCTRL
	select PINCTRL_LEO
	select PINCTRL_FTSCU010
	select PINCTRL_FTSCU010_GROUP
	select PM_OPP
	select SND_SOC_WM8731
	select VIRT_TO_BUS
	select WIRELESS_EXT
	select WEXT_PRIV
	select COMMON_CLK
	select TIMER_OF if OF
	select ARM_ARCH_TIMER
	select FTPWMTMR010
#	select ARM_LPAE

endchoice

#
# Core drivers
#

config CPU_HAS_GIC
	bool
	default y if CPU_FMP626 || CPU_CA9
	help
	  Use ARM GIC
```

## kernel/drivers/char/scm701_char/Kconfig
```kconfig
#
# scm701bus devices
#
#
config SCM701_CHAR
	tristate "scm701 char"
	depends on MACH_LEO
	help
	   scm701 char

if SCM701_CHAR

config SCM701_WATCHDOG
	tristate "scm701 watchdog"
	depends on MACH_LEO
	help
	   scm701 watchdog

config SCM701_SYSINFO
	tristate "scm701 sysinfo"
	depends on MACH_LEO
	help
	   scm701 sysinfo

endif # if SCM701_CHAR
```

## kernel/drivers/pinctrl/faraday/Kconfig
```kconfig
if ARCH_FARADAY || COMPILE_TEST

config PINCTRL_FTSCU010
	bool
	select PINMUX

config PINCTRL_FTSCU010_GROUP
	bool
	depends on PINCTRL_FTSCU010

config PINCTRL_A380
	bool "Faraday A380 pin controller driver"
	depends on MACH_A380
	select PINCTRL_FTSCU010

config PINCTRL_LEO
	bool "Faraday LEO pin controller driver"
	depends on MACH_LEO
	select PINCTRL_FTSCU010

if PINCTRL_LEO
	config PINCTRL_LEO_MODEX
	bool "Enable ModeX"
	
	config PINCTRL_LEO_RGMII
        bool "Enable Rgmii"

	config PINCTRL_LEO_RMII
        bool "Enable Rmii"
	
	config PINCTRL_LEO_MII
        bool "Enable Mii"
endif

endif
```

## kernel/drivers/video/fbdev/ftlcdc210/Kconfig
```kconfig
config FB_FTLCDC210
	tristate "Faraday FTLCDC210 LCD Controller support"
	depends on FB
	select FB_CFB_FILLRECT
	select FB_CFB_COPYAREA
	select FB_CFB_IMAGEBLIT
	help
		This framebuffer device driver is for the Faraday LCD
		Controller.  Faraday LCD Controller provide the building
		blocks for System on a Chip devices.
```

## kernel/sound/soc/faraday/Kconfig
```kconfig
config SND_SOC_FTSSP010_I2S
	tristate "Faraday FTSSP010 in I2S mode"
	select SND_SOC_GENERIC_DMAENGINE_PCM
	help
	  Faraday FTSSP010 in I2S mode

	  Say Y here to support the FARADAY FTSSP010 in I2S mode.
```

## scm801_mkimg/fit/kernel.its
```
/dts-v1/;

/ {
	description = "scm801 linux kernel and dtb";
	#address-cells = <1>;

	images {
		kernel@1{
			description = "scm801 linux kernel";
			data = /incbin/("../img/zImage");
			type = "kernel";
			arch = "arm";
			os = "linux";
			compression = "none";
			load = <0x82000000>;
			entry = <0x82000000>;
			hash-1 {
				algo = "crc32";
			};
		};

	
		
		fdt@1 {
			description = "scm801 fdt";
			data = /incbin/("../img/faraday_leo.dtb");
			type = "flat_dt";
			arch = "arm";
			compression = "none";
			load = <0x83000000>;
			hash@1 {
				algo = "crc32";
			};
		};
        };
	
	configurations {
		default = "config@1";
		config@1 {
			description = "scm801 smp boot linux kernel";
			kernel = "kernel@1";
			fdt = "fdt@1";
		};
	};
};
```
